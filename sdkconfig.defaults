## sdkconfig.defaults
```kconfig
# Scanner-standalone: Bluetooth discovery (Bluedroid dual-mode on ESP32)

CONFIG_BT_ENABLED=y
CONFIG_BT_BLUEDROID_ENABLED=y
CONFIG_BT_CONTROLLER_ENABLED=y
CONFIG_BTDM_CTRL_MODE_BTDM=y

CONFIG_BT_CLASSIC_ENABLED=y
CONFIG_BT_BLE_ENABLED=y

# Discovery only — no audio/serial profiles
# CONFIG_BT_A2DP_ENABLE is not set
# CONFIG_BT_SPP_ENABLED is not set
# CONFIG_BT_HFP_ENABLE is not set
# CONFIG_BT_HID_ENABLED is not set

CONFIG_BT_BLUEDROID_ESP_COEX_VSC=y
CONFIG_ESP_COEX_ENABLED=y
CONFIG_ESP_COEX_SW_COEXIST_ENABLE=y

CONFIG_BT_BLE_ACT_SCAN_REP_ADV_SCAN=y

# Save IRAM/flash — discovery uses GAP only
# CONFIG_BT_GATTS_ENABLE is not set
# CONFIG_BT_GATTC_ENABLE is not set
# CONFIG_BT_BLE_SMP_ENABLE is not set

CONFIG_COMPILER_OPTIMIZATION_SIZE=y

# Bluedroid dual-mode needs >1 MB app partition on ESP32
CONFIG_PARTITION_TABLE_SINGLE_APP_LARGE=y
```
